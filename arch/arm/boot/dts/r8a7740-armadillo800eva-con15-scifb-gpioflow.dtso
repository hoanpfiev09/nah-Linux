// SPDX-License-Identifier: GPL-2.0
//
// Device Tree Overlay for SCIFB on r8a7740/Armadillo-800 EVA Expansion
// Interface Connector, using GPIO-based RTS/CTS hardware flow control
//
// Copyright (C) 2016 Glider bvba
//
// Pinout:
//   - TXD = CON15 pin 40
//   - RXD = CON15 pin 41
//   - RTS = CON15 pin 44
//   - CTS = CON15 pin 47
//   - SCK = CON15 pin 42

/dts-v1/;
/plugin/;

#include <dt-bindings/gpio/gpio.h>

&pfc {
	scifb_pins: scifb {
		groups = "scifb_data_0", "scifb_clk_0";
		function = "scifb";
	};
};

&scifb {
	pinctrl-0 = <&scifb_pins>;
	pinctrl-names = "default";

	rts-gpios = <&pfc 23 GPIO_ACTIVE_LOW>;
	cts-gpios = <&pfc 21 GPIO_ACTIVE_LOW>;
	status = "okay";
};
