// SPDX-License-Identifier: GPL-2.0
//
// Device Tree Overlay for SCIFA5 on sh73a0/KZM-A9-GT CN8
//
// Copyright (C) 2015 Glider bvba
//
// Pinout:
//   - TXD = pin 64
//   - RXD = pin 66
//   - RTS# = pin 68
//   - CTS# = pin 70

/dts-v1/;
/plugin/;

&pfc {
	scifa5_pins: scifa5 {
		groups = "scifa5_data_0", "scifa5_ctrl_0";
		function = "scifa5";
	};
};

&scifa5 {
	pinctrl-0 = <&scifa5_pins>;
	pinctrl-names = "default";

	uart-has-rtscts;
	status = "okay";
};
