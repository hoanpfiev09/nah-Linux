// SPDX-License-Identifier: GPL-2.0
//
// Device Tree Overlay for SCIFA0 on r8a7740/Armadillo-800 EVA Expansion
// Interface Connector, using GPIO-based RTS/CTS hardware flow control
//
// Copyright (C) 2016 Glider bvba
//
// Pinout:
//   - TXD = CON15 pin 25
//   - RXD = CON15 pin 23
//   - RTS = CON15 pin 34
//   - CTS = CON15 pin 35

/dts-v1/;
/plugin/;

#include <dt-bindings/gpio/gpio.h>

&pfc {
	scifa0_pins: scifa0 {
		groups = "scifa0_data";
		function = "scifa0";
	};
};

&scifa0 {
	pinctrl-0 = <&scifa0_pins>;
	pinctrl-names = "default";

	rts-gpios = <&pfc 194 GPIO_ACTIVE_LOW>;
	cts-gpios = <&pfc 193 GPIO_ACTIVE_LOW>;
	status = "okay";
};
