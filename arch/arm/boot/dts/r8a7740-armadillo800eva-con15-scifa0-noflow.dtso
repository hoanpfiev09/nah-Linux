// SPDX-License-Identifier: GPL-2.0
//
// Device Tree Overlay for SCIFA0 on r8a7740/Armadillo-800 EVA Expansion
// Interface Connector, with RTS/CTS hardware flow control disabled
//
// Copyright (C) 2016 Glider bvba
//
// Pinout:
//   - TXD = CON15 pin 25
//   - RXD = CON15 pin 23

/dts-v1/;
/plugin/;

&pfc {
	scifa0_pins: scifa0 {
		groups = "scifa0_data";
		function = "scifa0";
	};
};

&scifa0 {
	pinctrl-0 = <&scifa0_pins>;
	pinctrl-names = "default";

	status = "okay";
};
