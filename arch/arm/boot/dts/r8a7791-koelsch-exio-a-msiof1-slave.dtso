// SPDX-License-Identifier: GPL-2.0
//
// Device Tree Overlay for MSIOF1 SPI slave on r8a7791/koelsch EXIO A
//
// Copyright (C) 2016 Glider bvba
//
// Pinout:
//   - CS# = EXIO A pin 48
//   - SCK = EXIO A pin 46
//   - MISO = EXIO A pin 54
//   - MOSI = EXIO A pin 56

/dts-v1/;
/plugin/;

&pfc {
	msiof1_pins: msiof1 {
		groups = "msiof1_clk", "msiof1_sync",
			 "msiof1_rx", "msiof1_tx";
		function = "msiof1";
	};
};

&msiof1 {
	pinctrl-0 = <&msiof1_pins>;
	pinctrl-names = "default";

	status = "okay";

	spi-slave;
};
