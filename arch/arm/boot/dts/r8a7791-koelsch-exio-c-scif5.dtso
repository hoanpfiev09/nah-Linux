// SPDX-License-Identifier: GPL-2.0
//
// Device Tree Overlay for SCIF5 on r8a7791/Koelsch EXIO Connector C
//
// Copyright (C) 2015 Glider bvba
//
// Pinout:
//   - TXD = EXIO Connector C pin 37
//   - RXD = EXIO Connector C pin 39
//
// Notes:
//   - As these pins are shared with SDHI2, the latter is disabled first.

/dts-v1/;
/plugin/;

&pfc {
	scif5_pins: scif5 {
		groups = "scif5_data_b";
		function = "scif5";
	};
};

&sdhi2 {
	status = "disabled";
};

&scif5 {
	pinctrl-0 = <&scif5_pins>;
	pinctrl-names = "default";

	status = "okay";
};
