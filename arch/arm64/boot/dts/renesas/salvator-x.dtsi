/*
 * Device Tree Source for the Salvator-X board
 *
 * Copyright (C) 2015-2016 Renesas Electronics Corp.
 *
 * This file is licensed under the terms of the GNU General Public License
 * version 2.  This program is licensed "as is" without any warranty of any
 * kind, whether express or implied.
 */

#include "salvator-common.dtsi"

/ {
	model = "Renesas Salvator-X board";
	compatible = "renesas,salvator-x";
};

&extal_clk {
	clock-frequency = <16666666>;
};

