// SPDX-License-Identifier: GPL-2.0
//
// Device Tree Overlay for MSIOF0 and spidev on Salvator-X(S) CP[1-4]
//
// Copyright (C) 2015 Glider bvba
//
// Pinout:
//   - CS# = CP4
//   - SCK = CP1
//   - MOSI = CP2
//   - MISO = CP3

/dts-v1/;
/plugin/;

&pfc {
	msiof0_pins: msiof0 {
		groups = "msiof0_clk", "msiof0_sync",
			 "msiof0_rxd", "msiof0_txd";
		function = "msiof0";
	};
};

&msiof0 {
	pinctrl-0 = <&msiof0_pins>;
	pinctrl-names = "default";

	#address-cells = <1>;
	#size-cells = <0>;
	status = "okay";

	spidev@0 {
		compatible = "spidev";
		reg = <0>;
		spi-max-frequency = <1000000>;
	};
};
